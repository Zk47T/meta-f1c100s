## conf/machine/f1c100s.conf
```bitbake
#@TYPE: Machine
#@NAME: F1C100s 
#@DESCRIPTION: Machine configuration for the F1C100s

TARGET_ARCH = "arm"

require conf/machine/include/arm/armv5/tune-arm926ejs.inc

SOC_FAMILY = "f1c100s"

PREFERRED_PROVIDER_virtual/kernel = "linux-f1c100s"
KERNEL_IMAGETYPE = "zImage"

#u-boot default in yocto
PREFERRED_PROVIDER_virtual/bootloader = "u-boot-f1c100s"

EXTRA_IMAGEDEPENDS += "u-boot-f1c100s"

#UBOOT_ENTRYPOINT  = "0x40008000"
#UBOOT_LOADADDRESS = "0x40008000"
UBOOT_MACHINE = "f1c100s_defconfig"
SPL_BINARY ?= "u-boot-sunxi-with-spl.bin"

SERIAL_CONSOLE = "115200 ttyS0"
# Scarthgap dùng SERIAL_CONSOLES (plural, "baudrate;device") để configure getty
SERIAL_CONSOLES = "115200;ttyS0"
SERIAL_CONSOLES_CHECK = "${SERIAL_CONSOLES}"

IMAGE_CLASSES += "sdcard_image-sunxi"
IMAGE_FSTYPES += "ext4 tar.xz jffs2 sunxi-sdimg"

MACHINE_ESSENTIAL_EXTRA_RDEPENDS = "kernel-image"

MACHINE_FEATURES = "ext2 ext4 tar.xz jffs2 serial usbhost vfat"
```
